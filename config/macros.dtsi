macro_right_arrow: macro_right_arrow{
compatible = "zmk,behavior-macro";
label = "macro_right_arrow";
#binding-cells = <0>;
bindings = <&kp SPACE>, <&kp MINUS>, <&kp GREATER_THAN>, <&kp SPACE>;
};
macro_arrow_left: macro_arrow_left{
compatible = "zmk,behavior-macro";
label = "macro_arrow_left";
#binding-cells = <0>;
bindings = <&kp SPACE>, <&kp LESS_THAN>, <&kp MINUS>, <&kp SPACE>;
};
macro_fat_arrow: macro_fat_arrow{
compatible = "zmk,behavior-macro";
label = "macro_fat_arrow";
#binding-cells = <0>;
bindings = <&kp SPACE>, <&kp EQUAL>, <&kp GT>, <&kp SPACE>;
};
